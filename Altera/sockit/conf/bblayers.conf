## Altera/sockit/conf/bblayers.conf
```bitbake
# LAYER_CONF_VERSION is increased each time build/conf/bblayers.conf
# changes incompatibly
LCONF_VERSION = "6"

BBPATH = "${TOPDIR}"
BBFILES ?= ""

BBLAYERS ?= " \
  /home/noel/yocto-dizzy/poky/meta \
  /home/noel/yocto-dizzy/poky/meta-yocto \
  /home/noel/yocto-dizzy/poky/meta-yocto-bsp \
  /home/noel/yocto-dizzy/poky/meta-altera \
  /home/noel/yocto-dizzy/poky/meta-linaro/meta-linaro-toolchain \
  "
BBLAYERS_NON_REMOVABLE ?= " \
  /home/noel/yocto-dizzy/poky/meta \
  /home/noel/yocto-dizzy/poky/meta-yocto \
  "
```

## Atmel/Core9g25/conf/bblayers.conf
```bitbake
LCONF_VERSION = "6"

BBPATH = "${TOPDIR}"
BSPDIR := "${@os.path.abspath(os.path.dirname(d.getVar('FILE', True)) + '/../../../..')}"

BBFILES ?= ""
BBLAYERS = " \
  ${BSPDIR}/sources/poky/meta \
  ${BSPDIR}/sources/poky/meta-yocto \
  ${BSPDIR}/sources/poky/meta-yocto-bsp \
  \
  ${BSPDIR}/sources/meta-openembedded/meta-oe \
  ${BSPDIR}/sources/meta-openembedded/meta-networking \
  ${BSPDIR}/sources/meta-openembedded/meta-multimedia \
  ${BSPDIR}/sources/meta-openembedded/meta-meta-python \
  ${BSPDIR}/sources/meta-openembedded/meta-meta-ruby \
  \
  ${BSPDIR}/sources/meta-atmel \
  ${BSPDIR}/sources/meta-qt5 \
"
```

## Atmel/Core9g25/conf/local.conf
```bitbake
# Machine Selection
MACHINE ??= "at91sam9x5ek"

BB_NUMBER_THREADS = '8'
PARALLEL_MAKE = '-j 8'

SOURCE_MIRROR_URL ?= "file:///${BSPDIR}/tarballs-atmel"
INHERIT += "own-mirrors"
BB_GENERATE_MIRROR_TARBALLS = "1"
#BB_NO_NETWORK = "1"

DL_DIR ?= "${TOPDIR}/downloads"

SSTATE_DIR ?= "${TOPDIR}/sstate-cache"

TMPDIR = "${TOPDIR}/tmp"

DISTRO ?= "poky-atmel"

PACKAGE_CLASSES ?= "package_deb"

EXTRA_IMAGE_FEATURES = "debug-tweaks"

USER_CLASSES ?= "buildstats image-mklibs image-prelink"

PATCHRESOLVE = "noop"

BB_DISKMON_DIRS = "\
    STOPTASKS,${TMPDIR},1G,100K \
    STOPTASKS,${DL_DIR},1G,100K \
    STOPTASKS,${SSTATE_DIR},1G,100K \
    ABORT,${TMPDIR},100M,1K \
    ABORT,${DL_DIR},100M,1K \
    ABORT,${SSTATE_DIR},100M,1K" 

#SSTATE_MIRRORS ?= "\
#file://.* http://someserver.tld/share/sstate/PATH;downloadfilename=PATH \n \
#file://.* file:///some/local/dir/sstate/PATH"

PACKAGECONFIG_append_pn-qemu-native = " sdl"
PACKAGECONFIG_append_pn-nativesdk-qemu = " sdl"
ASSUME_PROVIDED += "libsdl-native"

CONF_VERSION = "1"
```

## Freescale/wandboard-quad/conf/bblayers.conf
```bitbake
LCONF_VERSION = "6"

BBPATH = "${TOPDIR}"
BSPDIR := "${@os.path.abspath(os.path.dirname(d.getVar('FILE', True)) + '/../../../..')}"

BBFILES ?= ""

BBLAYERS ?= " \
  ${BSPDIR}/meta-atmel \
  ${BSPDIR}/meta-qt5 \
  ${BSPDIR}/meta \
  ${BSPDIR}/meta-yocto \
  ${BSPDIR}/meta-yocto-bsp \
  ${BSPDIR}/meta-openembedded/meta-oe \
  ${BSPDIR}/meta-openembedded/meta-networking \
  ${BSPDIR}/meta-openembedded/meta-python \
  ${BSPDIR}/meta-openembedded/meta-ruby \
  "
```

## Raspberrypi/model-b+/conf/bblayers.conf
```bitbake
LCONF_VERSION = "6"

BBPATH = "${TOPDIR}"
BSPDIR := "${@os.path.abspath(os.path.dirname(d.getVar('FILE', True)) + '/../../../..')}"

BBFILES ?= ""
BBLAYERS = " \
  ${BSPDIR}/sources/poky/meta \
  ${BSPDIR}/sources/poky/meta-yocto \
  \
  ${BSPDIR}/sources/meta-openembedded/meta-oe \
  ${BSPDIR}/sources/meta-openembedded/meta-multimedia \
  \
  ${BSPDIR}/sources/meta-raspberrypi \
"

#BBLAYERS ?= " \
#  /home/mytechpg/yocto/poki/meta \
#  /home/mytechpg/yocto/poki/meta-yocto \
#  /home/mytechpg/yocto/poki/meta-yocto-bsp \
#  /home/mytechpg/yocto/poki/meta-raspberrypi \
#  /home/mytechpg/yocto/poki/meta-openembedded/meta-multimedia \
#"
```
